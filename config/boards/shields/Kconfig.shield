## config/boards/shields/Kconfig.shield
```kconfig
config SHIELD_stealth_LEFT
    def_bool $(shields_list_contains,stealth_left)

config SHIELD_stealth_RIGHT
    def_bool $(shields_list_contains,stealth_right)
```
